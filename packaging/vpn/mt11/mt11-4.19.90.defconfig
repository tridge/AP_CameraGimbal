## packaging/vpn/mt11/mt11-4.19.90.defconfig
```kconfig
# CONFIG_LOCALVERSION_AUTO is not set
CONFIG_BPF_SYSCALL=y
CONFIG_NR_CPUS=4
# CONFIG_ARM64_LSE_ATOMICS is not set
CONFIG_COMPAT=y
CONFIG_MODULES=y
CONFIG_MODULE_UNLOAD=y
CONFIG_NET=y
CONFIG_INET=y
CONFIG_NETFILTER=y
CONFIG_NETDEVICES=y
CONFIG_TUN=m
CONFIG_DEBUG_FS=y
CONFIG_DEBUG_KERNEL=y
CONFIG_STACKTRACE=y
# CONFIG_FTRACE is not set
```

## packaging/vpn/zt30/zt30-4.9.227.defconfig
```kconfig
# CONFIG_LOCALVERSION_AUTO is not set
CONFIG_CGROUPS=y
CONFIG_PERF_EVENTS=y
CONFIG_JUMP_LABEL=y
CONFIG_CC_STACKPROTECTOR_REGULAR=y
CONFIG_MODULES=y
CONFIG_MODULE_UNLOAD=y
CONFIG_ARM_LPAE=y
# CONFIG_CACHE_L2X0 is not set
CONFIG_SMP=y
CONFIG_HOTPLUG_CPU=y
CONFIG_PREEMPT=y
CONFIG_THUMB2_KERNEL=y
CONFIG_HIGHMEM=y
CONFIG_ARM_MODULE_PLTS=y
CONFIG_CMA=y
# CONFIG_SUSPEND is not set
CONFIG_NET=y
CONFIG_INET=y
# CONFIG_INET_XFRM_MODE_TRANSPORT is not set
# CONFIG_INET_XFRM_MODE_TUNNEL is not set
# CONFIG_INET_XFRM_MODE_BEET is not set
# CONFIG_IPV6 is not set
CONFIG_CFG80211=m
CONFIG_CFG80211_WEXT=y
CONFIG_DMA_CMA=y
CONFIG_NETDEVICES=y
CONFIG_TUN=m
CONFIG_LIBERTAS=m
CONFIG_USB=m
CONFIG_USB_GADGET=m
CONFIG_DEBUG_KERNEL=y
# CONFIG_DEBUG_PREEMPT is not set
CONFIG_DEBUG_SPINLOCK=y
CONFIG_DEBUG_MUTEXES=y
# CONFIG_FTRACE is not set
```
